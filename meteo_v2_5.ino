#include <Arduino.h>

// Дефайны для EEPROM
// память давлений и другого
#define INIT_ADDR 1023  // номер резервной ячейки
#define INIT_KEY 50     // ключ первого запуска. 0-254, на выбор
#include <EEPROM.h>

// дефайны параметров
#define BUF_SIZE 12

/*--------------------------------
 Подключение датчиков
---------------------------------*/
//DHT11
#include "DHT.h"
#define DHTTYPE DHT11 
#define DHT11PIN 2
DHT dht(DHT11PIN, DHTTYPE);
// датчик давления-температуры
#include <GyverBME280.h>
GyverBME280 bme;


/* ------------------------------
 Подключение дисплея
 -----------------------*/
#include <GyverOLED.h>
GyverOLED<SSD1306_128x64, OLED_NO_BUFFER> oled;





/* -------------------------------------------
          Основные переменные
----------------------------------------------*/
// '1', 70x45px
const unsigned char pic1 [] PROGMEM = {
	0x00, 0x00, 0x00, 0x00, 0x00, 0x00, 0x00, 0x00, 0x00, 0x00, 0x00, 0x00, 0x00, 0x00, 0x00, 0x00, 
	0x00, 0x00, 0x00, 0x80, 0x80, 0x80, 0x80, 0x00, 0x00, 0x00, 0x00, 0x00, 0x00, 0x00, 0x00, 0x00, 
	0x00, 0x7c, 0xfe, 0xfe, 0xfc, 0x00, 0x00, 0x00, 0x00, 0x00, 0x00, 0x00, 0x00, 0x00, 0x00, 0x80, 
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	0x00, 0x00, 0x00, 0x00
};
// '2', 70x45px
const unsigned char pic2 [] PROGMEM = {
	0x00, 0x00, 0x00, 0x00, 0x00, 0x00, 0x00, 0x00, 0x00, 0x00, 0x00, 0x00, 0x00, 0x80, 0xc0, 0xc0, 
	0x80, 0x00, 0x00, 0x00, 0x00, 0x00, 0x00, 0x00, 0x00, 0x00, 0x00, 0x00, 0xff, 0xff, 0xfe, 0x00, 
	0x00, 0x00, 0x00, 0x00, 0x00, 0x00, 0x00, 0x00, 0x00, 0x00, 0x80, 0xc0, 0xc0, 0x80, 0x00, 0x00, 
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	0x00, 0x00, 0x00, 0x00
};
// '3', 70x45px
const unsigned char pic3 [] PROGMEM = {
	0x00, 0x00, 0x00, 0x00, 0x00, 0x00, 0x00, 0x00, 0x00, 0x00, 0x00, 0x00, 0x00, 0x00, 0x00, 0x00, 
	0x00, 0x80, 0xc0, 0xe0, 0xf0, 0xf0, 0xf8, 0xf8, 0xfc, 0xfc, 0x7c, 0x7c, 0x7e, 0x3e, 0x3e, 0x3e, 
	0x3e, 0x3e, 0x3e, 0x7e, 0x7c, 0x7c, 0xfc, 0xfc, 0xf8, 0xf8, 0xf0, 0xf0, 0xe0, 0xc0, 0x80, 0x00, 
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	0x00, 0x00, 0x00, 0x00
};
// '4', 70x45px
const unsigned char pic4 [] PROGMEM = {
	0x00, 0x00, 0x00, 0x00, 0x00, 0x00, 0x00, 0x00, 0x00, 0x00, 0x00, 0x00, 0x00, 0x00, 0x80, 0xc0, 
	0xc0, 0xe0, 0xe0, 0xf0, 0xf0, 0xf0, 0x70, 0x78, 0x78, 0x78, 0xf0, 0xf0, 0xf0, 0xf0, 0xe0, 0xe0, 
	0xc0, 0xc0, 0x80, 0x00, 0x00, 0x00, 0x00, 0x00, 0x00, 0x00, 0x00, 0x00, 0x00, 0x00, 0x00, 0x00, 
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	0x00, 0x00, 0x00, 0x00
};
// '5', 70x45px
const unsigned char pic5 [] PROGMEM = {
	0x00, 0x00, 0x00, 0x00, 0x00, 0x00, 0x00, 0x00, 0x00, 0x00, 0x00, 0x00, 0x00, 0x00, 0x00, 0x00, 
	0x00, 0x00, 0x00, 0x00, 0x00, 0x00, 0x00, 0x00, 0x00, 0x00, 0x00, 0x00, 0x00, 0x00, 0xe0, 0xe0, 
	0xc0, 0x80, 0x00, 0x00, 0x00, 0x00, 0x00, 0x00, 0x00, 0x7e, 0x7e, 0x7e, 0x00, 0x00, 0x00, 0x00, 
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	0x00, 0x00, 0x00, 0x00
};
// '6', 70x45px
const unsigned char pic6 [] PROGMEM = {
	0x00, 0x00, 0x00, 0x00, 0x00, 0x00, 0x00, 0x00, 0x00, 0x00, 0x00, 0x00, 0x80, 0xc0, 0xe0, 0xf0, 
	0xf8, 0x7c, 0x3c, 0x1e, 0x1e, 0x0e, 0x0f, 0x0f, 0x0f, 0x0f, 0x0f, 0x0f, 0x0e, 0x1e, 0x1e, 0x3c, 
	0x3c, 0x38, 0x10, 0x80, 0x80, 0xc0, 0xc0, 0xc0, 0xc0, 0xc0, 0xc0, 0xc0, 0xc0, 0x80, 0x80, 0x80, 
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	0x00, 0x00, 0x00, 0x00
};
// '7', 70x45px
const unsigned char pic7 [] PROGMEM = {
	0x00, 0x00, 0x00, 0x00, 0x00, 0x00, 0x00, 0x00, 0x00, 0x00, 0x00, 0x00, 0x00, 0x00, 0x00, 0x00, 
	0x00, 0x00, 0x00, 0x80, 0xe0, 0xf0, 0xf8, 0x38, 0x1c, 0x1c, 0x0e, 0x0e, 0x0e, 0x0e, 0x06, 0x0e, 
	0x0e, 0x0e, 0x0e, 0x1c, 0x3c, 0x38, 0xf0, 0xe0, 0xc0, 0x80, 0x00, 0x00, 0x00, 0x00, 0x00, 0x00, 
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	0x00, 0x00, 0x00, 0x00
};
// '8', 70x45px
const unsigned char pic8 [] PROGMEM = {
	0x00, 0x00, 0x00, 0x00, 0x00, 0x00, 0x00, 0x00, 0x00, 0x00, 0x00, 0x00, 0x00, 0x00, 0x00, 0x00, 
	0x00, 0x00, 0x00, 0x00, 0x00, 0x00, 0x00, 0x00, 0x00, 0x00, 0x00, 0x00, 0x00, 0x00, 0x00, 0x00, 
	0x30, 0x70, 0xe0, 0xc0, 0x00, 0x00, 0x00, 0x00, 0x80, 0x80, 0xbf, 0xbf, 0x00, 0x00, 0x00, 0x00, 
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	0x00, 0x00, 0x00, 0x00
};
// '9', 70x45px
const unsigned char pic9 [] PROGMEM = {
	0x00, 0x00, 0x00, 0x00, 0x00, 0x00, 0x00, 0x00, 0x00, 0x00, 0x00, 0x00, 0x00, 0x00, 0x00, 0x00, 
	0x00, 0x00, 0x00, 0xc0, 0xe0, 0xf0, 0x78, 0x38, 0x1c, 0x1c, 0x0e, 0x0e, 0x0e, 0x0e, 0x0e, 0x0e, 
	0x0e, 0x0e, 0x1c, 0x1c, 0x3c, 0x78, 0xf0, 0xe0, 0xc0, 0x80, 0x00, 0x00, 0x00, 0x00, 0x00, 0x00, 
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	0x00, 0x00, 0x00, 0x00
};
// '10', 70x45px
const unsigned char pic10 [] PROGMEM = {
	0x00, 0x00, 0x00, 0x00, 0x00, 0x00, 0x00, 0x00, 0x00, 0x00, 0x00, 0x00, 0x00, 0x00, 0x00, 0x00, 
	0x00, 0x00, 0x00, 0x80, 0xc0, 0xf0, 0xf8, 0x38, 0x1c, 0x1c, 0x0e, 0x0e, 0x06, 0x07, 0x07, 0x07, 
	0x06, 0x0e, 0x0e, 0x1c, 0x1c, 0x38, 0xf8, 0xf0, 0xc0, 0x00, 0x00, 0x00, 0x00, 0x00, 0x00, 0x00, 
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	0x00, 0x00, 0x00, 0x00
};
// '11', 70x45px
const unsigned char pic11 [] PROGMEM = {
	0x00, 0x00, 0x00, 0x00, 0x00, 0x00, 0x00, 0x00, 0x00, 0x00, 0x00, 0x00, 0x00, 0x00, 0x00, 0x00, 
	0x00, 0x00, 0x80, 0x80, 0xc0, 0xc0, 0xe0, 0xe0, 0x60, 0x60, 0xe0, 0xe0, 0xc0, 0xc0, 0x80, 0x80, 
	0x00, 0x60, 0x70, 0x3c, 0x1c, 0x0e, 0x06, 0x06, 0x06, 0x06, 0x06, 0x06, 0x0e, 0x1c, 0x3c, 0xf8, 
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	0x00, 0x00, 0x00, 0x00
};

// 'arrow', 15x15px
const unsigned char arrowUp [] PROGMEM = {
	0x00, 0x00, 0x00, 0x80, 0xc0, 0xe0, 0x70, 0x70, 0x38, 0x1f, 0x3f, 0x7e, 0x1e, 0x06, 0x02, 0x40, 
	0x38, 0x0e, 0x03, 0x01, 0x00, 0x00, 0x00, 0x00, 0x00, 0x00, 0x00, 0x00, 0x00, 0x00
};

// 'arrow1', 15x15px
const unsigned char arrowD [] PROGMEM = {
	0x01, 0x0e, 0x38, 0xe0, 0xc0, 0x80, 0x00, 0x00, 0x00, 0x00, 0x00, 0x00, 0x00, 0x00, 0x00, 0x00, 
	0x00, 0x00, 0x00, 0x01, 0x03, 0x07, 0x07, 0x0e, 0x7c, 0x7e, 0x3f, 0x3c, 0x30, 0x20
};

// 'wind', 40x30px
const unsigned char wind [] PROGMEM = {
	0x00, 0x00, 0x00, 0x00, 0x00, 0x00, 0x00, 0x00, 0x00, 0x00, 0x00, 0x00, 0x00, 0x00, 0x00, 0x00, 
	0x00, 0x00, 0x00, 0x00, 0x00, 0x00, 0x00, 0x30, 0x38, 0x0c, 0x0c, 0x0c, 0x0c, 0x1c, 0xf0, 0xc0, 
	0x00, 0x80, 0x80, 0x80, 0x80, 0x80, 0x00, 0x00, 0x00, 0x18, 0x18, 0x18, 0x18, 0x18, 0x18, 0x18, 
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	0x00, 0x00, 0x00, 0x06, 0x1e, 0x18, 0x30, 0x30, 0x18, 0x1c, 0x0f, 0x03, 0x00, 0x00, 0x00, 0x00
};

// таблица ссылок на рисунки для отрисовки их по адресу (ссылке) в памяти
const char* const name_array[] PROGMEM = {pic1, pic2, pic3, pic4, pic5, pic6, pic7, pic8, pic9, pic10, pic11};


byte deb=1; // вывод в порт для диагностики

int delta; // изменение давления в Па
long cond, pressure, pressure_array[BUF_SIZE], time_array[BUF_SIZE], aver_pressure; // прогноз в баллах, давление, массив давлений, массив времени
//unsigned long sumX, sumY, sumX2, sumXY; // суммы для МНК
float P, a, con= pow(1 - 225* 0.0065f / (20 + 225* 0.0065f + 273.15), -5.257), pmi, pma; // коэффициент наклона графика давлений, корректировка высоты (20 -температура в град, 225-высота в метрах), макс и мин значения давлений

uint32_t t1=5000, t2=5000; // время работы экрана для отображения данных с датчиков и прогноза; графика давления
uint32_t t3=1800000; // период предсказания погоды

// флаги для переключения экранов
bool flgS1=false, flgS2=false, flgS3=false, flgM=false; // первый экран, второй экран, меню

// флаги для настройки
bool Season=true, Err=false, Rea=false; // сезон (по умолчанию лето), сброс, принудительное чтение из памяти
bool diaFlag = false, figFlag = true; // флаг вывода диагностики, флаг отображения графика - столбики или черточки

int clicks;
uint32_t tmr1, tmr2;

/* -------------------------------------------
             Подключение кнопки
----------------------------------------------*/
#define BTN_PIN 3				// кнопка подключена сюда (BTN_PIN --- КНОПКА --- GND)
#include "GyverButton.h"
GButton butt1(BTN_PIN);

long aver_sens() {// усреднение давления
  pressure = 0;
  for (byte i = 0; i < 10; i++) {
    P = (float)bme.readPressure();
    pressure += P;
  }
  aver_pressure = pressure / 10;
  return aver_pressure;
}

// НАСТРОЙКА НА ЭТАПЕ ЗАПУСКА
void setup() {
  // натройка кнопки
  butt1.setDebounce(50);        // настройка антидребезга (по умолчанию 80 мс)
  butt1.setTimeout(300);        // настройка таймаута на удержание (по умолчанию 500 мс)
  butt1.setClickTimeout(300);   // настройка таймаута между кликами (по умолчанию 300 мс)
  butt1.setType(HIGH_PULL);
  butt1.setDirection(NORM_CLOSE);
  butt1.setTickMode(AUTO);

  // ИНИЦИАЛИЗАЦИЯ ДАТЧИКОВ, ДИСПЛЕЕВ И ПОРТА
  Serial.begin(9600);
  oled.init();              // инициализация
  bme.begin(0x76);
  dht.begin(); // запускаем датчик DHT11


  // считывание параметров при запуске
  EEPROM.get(600, Season);
  EEPROM.get(601, figFlag);
  EEPROM.get(602, diaFlag);
  EEPROM.get(603, t1);

  // ОТРИСОВКА ЗАСТАВКИ
  oled.clear();
  oled.setCursor(0,0);
  oled.print("Погодная станция");
  oled.setCursor(0,1);
  oled.print("V2.5...");
  oled.setCursor(0,2);
  oled.print("инициализация...");
  oled.update();
  delay(1000);
  oled.setCursor(0,3);
  //pressure = bme.readPressure() * con;
  pressure = aver_sens()* con;

  bool first=false;
  if ((EEPROM.read(INIT_ADDR) != INIT_KEY)) {
    Serial.print(first);
    first = true;
  }
  memory(first, true, false);// флаги: первый старт, считывание, запись
  
  predict();
  oled.print("Готово!");
  if (delta>150) oled.print("Растет");
  else if (delta<-150) oled.print("Падает");
  else oled.print("Стабильно");
  oled.setCursor(0, 4);
  oled.print("Прогноз:");
  oled.setCursor(20, 5);
  oled.print(cond);
  oled.setCursor(0, 6);
  oled.print((EEPROM.read(INIT_ADDR) != INIT_KEY));
  oled.print(Season);
  oled.print(Rea);
  oled.print(Err+first);
  oled.update();
  delay(1000);
  oled.clear();
  predict(); 
}



// ОСНОВНОЙ ЦИКЛ
void loop() {
  
  // место расчтета прогноза погоды
  static uint32_t tmr; 
  if (millis()-tmr>t3){
    tmr=millis();
    predict();
    memory(false, false, true);// флаги: первый старт, считывание, запись, сброс
  }

  static int dia;
  if (diaFlag) dia=1;
  else dia=0;

  if (butt1.isClick()) {
    //static uint32_t yt;
    //EEPROM.get(603, yt);
    //Serial.println(yt);
    butt1.resetStates();
    clicks+=1;
    if (clicks>2+dia) clicks=0;
  }

  while(clicks>0 && clicks<=2+dia){// && !butt1.isHolded()
    if (butt1.isClick()) clicks+=1;
    if (clicks==1 && !flgS1) {
      butt1.resetStates();
      tmr1=millis();
      flgS1=!flgS1;
      s1();
    }
    if (clicks==2 && !flgS2) {
      butt1.resetStates();
      tmr1=millis();
      flgS2=!flgS2;
      s2();
    }
    if (clicks==3 && diaFlag && !flgS3) {
      butt1.resetStates();
      tmr1=millis();
      flgS3=!flgS3;
      s3();
    }
    if (millis()-tmr1>t1 || clicks>(2+dia)) {
      oled.clear();
      if (flgS1) flgS1=!flgS1;
      if (flgS2) flgS2=!flgS2;
      if (flgS3) flgS3=!flgS3;
      clicks=0;
      //butt1.resetStates();
      //Serial.println(millis()-tmr1);
      //Serial.println(clicks);
      //Serial.print((2+dia));
      //Serial.println();
    }
  }

  if (butt1.isHold() && !flgM){
    // вход в меню
    oled.clear();
    flgM=true;
    menu();
    clicks=0;
    butt1.resetStates();
  }
}


/*--------------------------------------------

Функции для расчетов, отображения и настройки

----------------------------------------------*/

//функция для считывания и записи в память
void memory(bool flag1, bool flag2, bool flag3){// флаги: первый старт, считывание, запись
  if (flag1){ // при первом запуске обновление списка давлений
    Serial.println("Первый запуск");
    EEPROM.write(INIT_ADDR, INIT_KEY);    // записали ключ
    for (int i = 0; i < BUF_SIZE; i++) {   // счётчик от 0 до 5
      pressure_array[i] = pressure;  // забить весь массив текущим давлением
      //time_array[i] = i;             // забить массив времени числами 0 - 5
      EEPROM.put(i*4, pressure);// записали стандартное значение
      //EEPROM.put(BUF_SIZE*4+2*i, i);// записали стандартное значение
    }
  }
  if (flag2){ // при поднятом флаге считывания считать 
    for (int i = 0; i < BUF_SIZE; i++) {   // счётчик от 0 до 5
      EEPROM.get(i*4, pressure_array[i]);
      //EEPROM.get(BUF_SIZE*4+2*i, time_array[i]);
      //Serial.println(pressure_array[i]);
    }
  }

  if (flag3){
    for (int i = 0; i < BUF_SIZE; i++) {   // счётчик от 0 до 5
      EEPROM.put(i*4, pressure_array[i]);
      //Serial.println(pressure_array[i]);
    }
  }
}

// предсказание погоды
void predict(){
  float seas;
  if (Season) seas=2.0;
  else seas=0.0;
  //pressure = bme.readPressure() * con;
  pressure = aver_sens()* con;
  memory(false, Rea, false);// флаги: первый старт, считывание, запись, сброс
  if (Rea) Rea=false;
  
  for (byte i = 0; i < BUF_SIZE-1; i++) pressure_array[i] = pressure_array[i + 1];     // сдвинуть массив давлений КРОМЕ ПОСЛЕДНЕЙ ЯЧЕЙКИ на шаг назад

  pressure_array[BUF_SIZE-1] = pressure;// последний элемент массива теперь - новое давление                  

  delta = (long)(pressure_array[11]-pressure_array[7]);
  a=delta/5;

  if (delta>150) cond = (long)(160.0 - 0.155 * pressure/100-seas);
  else if (delta<-150) cond = (long)(130.0 - 0.124 * pressure/100+seas);
  else cond = (long)(138 - 0.133 * pressure/100);  
  
  if (deb==1) {  
    Serial.println(a);
    Serial.println(delta);
    Serial.println(cond);
  }

  if (cond<0) cond=0;
  if (cond>11) cond=11;

}


// отрисовка первого экрана
void s1(){  
  oled.setCursorXY(5, 0);
  oled.setScale(2);
  oled.print(bme.readTemperature(), 1);
  oled.circle(55, 2, 2, 1);
  oled.setCursor(80, 0);
  oled.print(dht.readHumidity(), 0);
  oled.print("%");
  oled.setScale(1);
  oled.setCursorXY(75, 16);
  oled.print(pressureToMmHg(bme.readPressure()), 1);
  oled.setCursorXY(90, 28);
  oled.print("mmHg");
  if (abs(pressure_array[BUF_SIZE-1]-pressure_array[BUF_SIZE-3])>100) oled.drawBitmap(75, 45, wind, 40, 30);
  if (delta>150) oled.drawBitmap(75, 25, arrowUp, 15, 15);
  else if (delta<-150) oled.drawBitmap(75, 25, arrowD, 15, 15);
  else {
    oled.setCursorXY(75, 25);
    oled.print("||");
    //oled.drawBitmap(75, 25, arrowUp, 15, 15);
  }
  oled.drawBitmap(2, 18, (const char*)pgm_read_word(&name_array[cond]), 70, 45);
  oled.setCursorXY(55, 22);
  oled.print(cond);  
  oled.setCursorXY(2, 22);
   if (Season) oled.print("Л");
   else  oled.print("З");
  oled.update();
}


// отрисовка второго экрана
void s2(){
  oled.clear();
  oled.setCursor(0, 0);
  oled.print("P/h ||1|2|3|4|5|6");
  pmi=pressure_array[0]; pma=pressure_array[0];
  for (byte ip=1; ip<BUF_SIZE; ip++){
    if (pmi>pressure_array[ip]) pmi=pressure_array[ip];
    if (pma<pressure_array[ip]) pma=pressure_array[ip];
  }
  pmi=pressureToMmHg(pmi/con); pma=pressureToMmHg(pma/con);
  Serial.println(pmi);
  Serial.println(pma);
  Serial.println(delta);
  Serial.println(cond);
  for (int yt=1; yt<8; yt++){
    oled.setCursor(0, (yt));
    oled.print(((pma+1)-(pma-pmi+2)/6*(yt-1)),1);
  }
  int ytt;
  for (int o=0; o<BUF_SIZE; o++){
    int pO = int(((pma+1)*100-pressureToMmHg(pressure_array[o]/con)*100)/((pma-pmi+2)*100)*55);//map(pressureToMmHg(pressure_array[o]/con), pmi-1, pma+1, 55, 0);//
    if (figFlag) oled.rect(int(32+6*o), 8+pO, int(32+3+6*o), 63);// прямоугольник (x0,y0,x1,y1)
    else oled.rect(int(32+6*o), 8+pO, int(32+3+6*o), 9+pO);// полоска (x0,y0,x1,y1) ширина 1 пикселя
    if (o==BUF_SIZE-3) ytt=pO;
  }
  if (delta>0) {
    oled.setCursorXY(int(32+6*(BUF_SIZE-3)),ytt-3);
    oled.print(delta);
  }
  if (delta<=0) {
    oled.setCursorXY(int(32+6*(BUF_SIZE-3)),ytt+15);
    oled.print(delta);
  }
  oled.update();
}

// экран диагностики: вызывает пренудительно прогноз, выводи флаги, данные с датчиков, текущие переменные
void s3(){
  //predict();
  oled.clear();
  oled.home();
  oled.print("H      T     P");
  oled.setCursor(0,1);
  oled.print(dht.readHumidity(), 2);
  oled.print("; ");
  oled.print(bme.readTemperature(), 1);
  oled.print("; ");
  oled.print(pressureToMmHg(bme.readPressure()), 2);

  oled.setCursor(0,2);
  oled.print("delta  cast  seas");
  oled.setCursor(0,3);
  oled.print(delta);
  oled.print("; ");
  oled.print(cond);
  oled.print(";  ");
  oled.print(Season);

  oled.setCursor(0,4);
  oled.print("R  E  F");
  oled.setCursor(0,5);
  oled.print(Rea);
  oled.print("; ");
  oled.print(Err);
  oled.print("; ");
  oled.print((EEPROM.read(INIT_ADDR) != INIT_KEY));
  oled.print("; ");

  oled.setCursor(0,6);
  oled.print("Время с запуска:");
  oled.setCursor(0,7);
  oled.print(millis()/1000);
  oled.print("s; ");
  oled.update();

}

// меню настройки: один клик - переместить курсор; двойной клик выбрать; удержание - применить, если в основном меню выход
void menu() {
  static uint8_t point=2;
  // блок отрисовки пунктов меню
  oled.home();
  oled.print
  (F(
    "  НАСТРОЙКИ \n\r"
    "____________________ \n\r"
    "    Сезон \n\r"
    "    Считать график \n\r"
    "    Сбросить график \n\r"
    "    Таймаут экрана \n\r"
    "    Вкл. диаг. экр. \n\r"
    "    Отобр. графика \n\r"
  ));
  printPointer(point);
  oled.update();
  clicks=0;
  // бесконечный цикл, чтобы меню работало
  while (1){
    if (butt1.isSingle()) clicks=1;// || butt1.isHolded()
    if (butt1.isDouble()) clicks=2;
    switch (clicks){
      case 0: break; // ничего не делать
      case 1: { // циклически перемещать курсор
        point++;
        if (point>7) point=2;
        printPointer(point);
        oled.update();
        clicks=0;
        break;
      }
      case 2: { // выбор пункта
        printPointerActive(point);
        while (clicks!=0){    
          if (point==2){// первый пункт меню: выбор сезона
            clicks=1;
            if (butt1.isDouble()) clicks=2;
            oled.setCursor(5, point);
            if (Season) oled.print(" Л ");
            else oled.print(" З ");
            if (butt1.isSingle()) Season = !Season; // изменение параметра
            else if (clicks==2) {
              clicks=0;
              break; // выход из цикла в пункте
            }
          }

          if (point==3){// второй пункт меню: выбор считать или нет
            clicks=1;
            if (butt1.isDouble()) clicks=2;
            oled.setCursor(5, point);
            if (Rea) oled.print("Да ");
            else oled.print("Нет");
            if (butt1.isSingle()) Rea = !Rea; // изменение параметра
            else if (clicks==2) {
              clicks=0;
              break; // выход из цикла в пункте
            }
          }

          if (point==4){// третий пункт меню: выбор сбросить или нет
            clicks=1;
            if (butt1.isDouble()) clicks=2;
            oled.setCursor(5, point);
            if (Err) oled.print("Да ");
            else oled.print("Нет");
            if (butt1.isSingle()) Err = !Err; // изменение параметра
            else if (clicks==2) {
              if (!Err) EEPROM.write(INIT_ADDR, INIT_KEY);    // записали ключ
              if (Err) EEPROM.write(INIT_ADDR, 100);    // записали ключ
              clicks=0;
              break; // выход из цикла в пункте
            }
          }

          if (point==5){// четвертый пункт меню: выбор таймаута от 1 сек до 10 сек
            clicks=1;
            if (butt1.isDouble()) clicks=2;
            oled.setCursor(5, point);
            oled.print(t1/1000);
            oled.print("с");
            if (butt1.isSingle()) t1=t1+1000; // изменение параметра с инкрементом 1 сек
            else if (t1>10000) t1=1000; // изменение параметра
            else if (clicks==2) {
              clicks=0;
              break; // выход из цикла в пункте
            }
          }

          if (point==6){// пятый пункт меню: отображение диагностики третьим экраном
            clicks=1;
            if (butt1.isDouble()) clicks=2;
            oled.setCursor(5, point);
            if (diaFlag) oled.print("Да ");
            else oled.print("Нет");
            if (butt1.isSingle()) diaFlag=!diaFlag; // изменение параметра
            else if (clicks==2) {
              clicks=0;
              break; // выход из цикла в пункте
            }
          }

          if (point==7){// шестой пункт меню: отображение графика столбиками или точками
            clicks=1;
            if (butt1.isDouble()) clicks=2;
            oled.setCursor(5, point);
            if (figFlag) oled.print("|| ");
            else oled.print("-- ");
            if (butt1.isSingle()) figFlag=!figFlag; // изменение параметра
            else if (clicks==2) {
              clicks=0;
              break; // выход из цикла в пункте
            }
          }
          oled.update();
        }
        printPointer(point);
        oled.setCursor(5, point);
        oled.print("   ");
        oled.update();
        clicks=0;
        break;
      }
    }
    if (butt1.isHolded() && butt1.isHold()) {
      flgM=!flgM;
      break;
    }
  }
  if (!flgM){
    oled.clear();
    EEPROM.put(600, Season);    // записали ключ Сезона
    EEPROM.put(601, figFlag);    // записали ключ Графика
    EEPROM.put(602, diaFlag);    // записали ключ ДИагностики
    EEPROM.put(603, t1);    // записали таймаут
    clicks=0;
    return; // return возвращает нас в предыдущее меню
  }
}

// неактивный указатель
void printPointer(uint8_t pointer) {
  // Указатель в начале строки
  for (int i=0; i<8; i++){
    oled.setCursor(0, i);
    oled.print(" ");
  }

  oled.setCursor(0, pointer);
  oled.print(">");

}

// активный указатель
void printPointerActive(uint8_t pointer) {
  // Указатель в начале строки
  oled.setCursor(0, pointer);
  oled.print("=");
}